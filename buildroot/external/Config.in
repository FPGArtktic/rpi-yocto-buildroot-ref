## buildroot/external/package/rtk-fail-compile/Config.in
```kconfig
config BR2_PACKAGE_RTK_FAIL_COMPILE
	bool "rtk-fail-compile"
	help
	  C program that does not compile, on purpose. Build it with
	  `make rtk-fail-compile` to capture the output of a failing
	  package build. Never enable it in a real configuration.
```

## yocto/meta-rpi-ref/conf/layer.conf
```bitbake
BBPATH .= ":${LAYERDIR}"

BBFILES += "${LAYERDIR}/recipes-*/*/*.bb \
            ${LAYERDIR}/recipes-*/*/*.bbappend"

BBFILE_COLLECTIONS += "rpi-ref"
BBFILE_PATTERN_rpi-ref = "^${LAYERDIR}/"
BBFILE_PRIORITY_rpi-ref = "10"

LAYERDEPENDS_rpi-ref = "core raspberrypi"
LAYERSERIES_COMPAT_rpi-ref = "scarthgap"
```
